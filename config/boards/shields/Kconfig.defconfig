## config/boards/shields/Kconfig.defconfig
```kconfig
# Copyright (c) 2020 The ZMK Contributors
# SPDX-License-Identifier: MIT

if SHIELD_FINGER6_LEFT

    config ZMK_KEYBOARD_NAME
        default "finger6"

    config ZMK_SPLIT_ROLE_CENTRAL
        default y

endif

if SHIELD_FINGER6_LEFT || SHIELD_FINGER6_RIGHT

    config ZMK_SPLIT
        default y

endif
```

## config/boards/shields/Kconfig.shield
```kconfig
# Copyright (c) 2020 The ZMK Contributors
# SPDX-License-Identifier: MIT

config SHIELD_FINGER6_LEFT
    def_bool $(shields_list_contains,finger6_left)

config SHIELD_FINGER6_RIGHT
    def_bool $(shields_list_contains,finger6_right)
```

## config/boards/shields/finger6/Kconfig.shield
```kconfig
# Copyright (c) 2020 The ZMK Contributors
# SPDX-License-Identifier: MIT

config SHIELD_HELIX_LEFT
    def_bool $(shields_list_contains,finger6_left)

config SHIELD_HELIX_RIGHT
    def_bool $(shields_list_contains,finger6_right)
```
